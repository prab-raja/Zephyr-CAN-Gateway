## CMakeLists.txt
```
cmake_minimum_required(VERSION 3.20.0)

# Compiler flag configurations
set(CONFIG_CAN_CONTROLLER "1" CACHE STRING "CAN Controller selection (1 or 2)")
set(CONFIG_USE_CANFD "n" CACHE STRING "Enable CAN-FD support (y or n)")
set(CONFIG_FILTER_MODE "whitelist" CACHE STRING "Filter mode (whitelist or blacklist)")

# Pass to C preprocessor
add_compile_definitions(
    CAN_CONTROLLER=${CONFIG_CAN_CONTROLLER}
    USE_CANFD=$<IF:$<STREQUAL:${CONFIG_USE_CANFD},y>,1,0>
    FILTER_MODE_WHITELIST=$<IF:$<STREQUAL:${CONFIG_FILTER_MODE},whitelist>,1,0>
)

find_package(Zephyr REQUIRED HINTS $ENV{ZEPHYR_BASE})
project(can_gateway)

# Source files
target_sources(app PRIVATE
    src/main.c
    src/can_router.c
    src/uart_diagnostics.c
    src/filter.c
)

# Include directories
target_include_directories(app PRIVATE
    src
)

# Print configuration
message(STATUS "========================================")
message(STATUS "CAN Gateway Configuration:")
message(STATUS "  CAN Controller: ${CONFIG_CAN_CONTROLLER}")
message(STATUS "  CAN-FD Support: ${CONFIG_USE_CANFD}")
message(STATUS "  Filter Mode: ${CONFIG_FILTER_MODE}")
message(STATUS "========================================")
```

## prj.conf
```kconfig
# Zephyr CAN Gateway Configuration

# Kernel Configuration
CONFIG_MAIN_STACK_SIZE=2048
CONFIG_SYSTEM_WORKQUEUE_STACK_SIZE=2048
CONFIG_HEAP_MEM_POOL_SIZE=4096

# CAN Configuration
CONFIG_CAN=y
CONFIG_CAN_INIT_PRIORITY=80
CONFIG_CAN_MAX_FILTER=14
CONFIG_CAN_RX_TIMESTAMP=y

# CAN Statistics
CONFIG_CAN_STATS=y

# UART Configuration
CONFIG_SERIAL=y
CONFIG_UART_INTERRUPT_DRIVEN=y
CONFIG_UART_LINE_CTRL=y

# Shell for diagnostics
CONFIG_SHELL=y
CONFIG_SHELL_BACKEND_SERIAL=y
CONFIG_SHELL_PROMPT_UART="can-gw:~$ "
CONFIG_SHELL_CMD_BUFF_SIZE=256
CONFIG_SHELL_PRINTF_BUFF_SIZE=256

# Logging
CONFIG_LOG=y
CONFIG_LOG_MODE_IMMEDIATE=y
CONFIG_LOG_DEFAULT_LEVEL=3
CONFIG_CAN_LOG_LEVEL_DBG=y

# Enable printk for early debugging
CONFIG_PRINTK=y
CONFIG_EARLY_CONSOLE=y

# Timers
CONFIG_TIMER=y

# GPIO (for status LEDs)
CONFIG_GPIO=y

# Memory protection (optional but recommended)
CONFIG_THREAD_STACK_INFO=y
CONFIG_THREAD_NAME=y

# Performance
CONFIG_MAIN_THREAD_PRIORITY=7
CONFIG_SYSTEM_WORKQUEUE_PRIORITY=10

# Assert for debugging
CONFIG_ASSERT=y
CONFIG_ASSERT_LEVEL=2
```

## src/main.c
```c
#include <zephyr/kernel.h>
#include <zephyr/device.h>
#include <zephyr/drivers/can.h>
#include <zephyr/drivers/uart.h>
#include <zephyr/shell/shell.h>
#include <zephyr/logging/log.h>

LOG_MODULE_REGISTER(main, LOG_LEVEL_DBG);

/* Compile-time configuration */
#ifndef CAN_CONTROLLER
#define CAN_CONTROLLER 1
#endif

#ifndef USE_CANFD
#define USE_CANFD 0
#endif

#ifndef FILTER_MODE_WHITELIST
#define FILTER_MODE_WHITELIST 1
#endif

/* Device selection based on compiler flags */
#if CAN_CONTROLLER == 1
#define CAN_DEV_NODE DT_ALIAS(can0)
#elif CAN_CONTROLLER == 2
#define CAN_DEV_NODE DT_ALIAS(can1)
#else
#error "Invalid CAN_CONTROLLER value. Must be 1 or 2"
#endif

/* External function declarations */
extern void can_router_init(const struct device *can_dev);
extern void uart_diagnostics_init(void);
extern void filter_init(bool whitelist_mode);
extern void can_router_start(void);

/* Configuration info */
static void print_config(void)
{
    LOG_INF("========================================");
    LOG_INF("Zephyr CAN Gateway - Configuration");
    LOG_INF("========================================");
    LOG_INF("CAN Controller: %d", CAN_CONTROLLER);
    LOG_INF("CAN-FD Support: %s", USE_CANFD ? "Enabled" : "Disabled");
    LOG_INF("Filter Mode: %s", FILTER_MODE_WHITELIST ? "Whitelist" : "Blacklist");
    LOG_INF("Zephyr Version: %s", KERNEL_VERSION_STRING);
    LOG_INF("========================================");
}

int main(void)
{
    const struct device *can_dev;
    int ret;

    LOG_INF("Starting Zephyr CAN Gateway...");
    
    print_config();

    /* Get CAN device */
    can_dev = DEVICE_DT_GET(CAN_DEV_NODE);
    if (!device_is_ready(can_dev)) {
        LOG_ERR("CAN device not ready");
        return -1;
    }

    LOG_INF("CAN device: %s ready", can_dev->name);

#if USE_CANFD
    /* Set CAN-FD mode */
    ret = can_set_mode(can_dev, CAN_MODE_FD);
    if (ret != 0) {
        LOG_ERR("Failed to set CAN-FD mode: %d", ret);
        return -1;
    }
    LOG_INF("CAN-FD mode enabled");
#else
    /* Set normal CAN mode */
    ret = can_set_mode(can_dev, CAN_MODE_NORMAL);
    if (ret != 0) {
        LOG_ERR("Failed to set CAN mode: %d", ret);
        return -1;
    }
    LOG_INF("Classic CAN mode enabled");
#endif

    /* Start CAN interface */
    ret = can_start(can_dev);
    if (ret != 0) {
        LOG_ERR("Failed to start CAN: %d", ret);
        return -1;
    }

    /* Initialize filter with compile-time mode */
    filter_init(FILTER_MODE_WHITELIST);

    /* Initialize UART diagnostics */
    uart_diagnostics_init();

    /* Initialize and start CAN router */
    can_router_init(can_dev);
    can_router_start();

    LOG_INF("CAN Gateway initialized successfully");
    LOG_INF("Ready to route CAN messages");

    /* Main loop - keep alive */
    while (1) {
        k_sleep(K_SECONDS(10));
        LOG_DBG("Gateway running...");
    }

    return 0;
}
```

## src/can_router.c
```c
#include <zephyr/kernel.h>
#include <zephyr/device.h>
#include <zephyr/drivers/can.h>
#include <zephyr/logging/log.h>
#include <string.h>

LOG_MODULE_REGISTER(can_router, LOG_LEVEL_DBG);

static const struct device *can_device;
static struct k_work_q can_work_q;
static K_THREAD_STACK_DEFINE(can_work_q_stack, 2048);

/* Statistics */
static struct {
    uint32_t rx_count;
    uint32_t tx_count;
    uint32_t filtered_count;
    uint32_t error_count;
} stats;

/* External filter function */
extern bool filter_check_id(uint32_t can_id);

/* Work item for CAN frame processing */
struct can_work_item {
    struct k_work work;
    struct can_frame frame;
    uint32_t timestamp;
};

#define CAN_WORK_POOL_SIZE 10
static struct can_work_item work_pool[CAN_WORK_POOL_SIZE];
static uint8_t work_pool_idx = 0;

/* Process received CAN frame */
static void can_frame_work_handler(struct k_work *work)
{
    struct can_work_item *item = CONTAINER_OF(work, struct can_work_item, work);
    int ret;

    /* Check filter */
    if (!filter_check_id(item->frame.id)) {
        stats.filtered_count++;
        LOG_DBG("Frame filtered: ID 0x%03X", item->frame.id);
        return;
    }

    /* Route/forward the frame */
    ret = can_send(can_device, &item->frame, K_MSEC(100), NULL, NULL);
    if (ret == 0) {
        stats.tx_count++;
        LOG_DBG("Routed frame: ID 0x%03X, DLC %d", item->frame.id, item->frame.dlc);
    } else {
        stats.error_count++;
        LOG_ERR("Failed to route frame: %d", ret);
    }
}

/* CAN RX callback */
static void can_rx_callback(const struct device *dev, struct can_frame *frame,
                           void *user_data)
{
    struct can_work_item *item;

    stats.rx_count++;

    /* Get work item from pool */
    item = &work_pool[work_pool_idx];
    work_pool_idx = (work_pool_idx + 1) % CAN_WORK_POOL_SIZE;

    /* Copy frame data */
    memcpy(&item->frame, frame, sizeof(struct can_frame));
    item->timestamp = k_cycle_get_32();

    /* Submit to work queue for processing */
    k_work_submit_to_queue(&can_work_q, &item->work);
}

/* Initialize CAN router */
void can_router_init(const struct device *can_dev)
{
    can_device = can_dev;

    /* Initialize work queue */
    k_work_queue_init(&can_work_q);
    k_work_queue_start(&can_work_q, can_work_q_stack,
                      K_THREAD_STACK_SIZEOF(can_work_q_stack),
                      K_PRIO_PREEMPT(5), NULL);

    /* Initialize work items */
    for (int i = 0; i < CAN_WORK_POOL_SIZE; i++) {
        k_work_init(&work_pool[i].work, can_frame_work_handler);
    }

    /* Reset statistics */
    memset(&stats, 0, sizeof(stats));

    LOG_INF("CAN router initialized");
}

/* Start CAN routing */
void can_router_start(void)
{
    struct can_filter filter;
    int ret;

    /* Accept all frames - filtering done in software */
    filter.id = 0;
    filter.mask = 0;
    filter.flags = 0;

    ret = can_add_rx_filter(can_device, can_rx_callback, NULL, &filter);
    if (ret < 0) {
        LOG_ERR("Failed to add RX filter: %d", ret);
        return;
    }

    LOG_INF("CAN router started, filter ID: %d", ret);
}

/* Get statistics */
void can_router_get_stats(uint32_t *rx, uint32_t *tx, uint32_t *filtered, uint32_t *errors)
{
    if (rx) *rx = stats.rx_count;
    if (tx) *tx = stats.tx_count;
    if (filtered) *filtered = stats.filtered_count;
    if (errors) *errors = stats.error_count;
}

/* Reset statistics */
void can_router_reset_stats(void)
{
    memset(&stats, 0, sizeof(stats));
    LOG_INF("Statistics reset");
}
```

## src/filter.c
```c
#include <zephyr/kernel.h>
#include <zephyr/logging/log.h>
#include <stdbool.h>

LOG_MODULE_REGISTER(filter, LOG_LEVEL_DBG);

/* Filter configuration */
static bool whitelist_mode;

/* Filter lists - configurable at runtime via shell */
#define MAX_FILTERS 32
static uint32_t filter_list[MAX_FILTERS];
static uint8_t filter_count = 0;

/* Initialize filter module */
void filter_init(bool is_whitelist)
{
    whitelist_mode = is_whitelist;
    filter_count = 0;

    LOG_INF("Filter initialized: %s mode", 
            whitelist_mode ? "Whitelist" : "Blacklist");
}

/* Add CAN ID to filter list */
bool filter_add_id(uint32_t can_id)
{
    if (filter_count >= MAX_FILTERS) {
        LOG_ERR("Filter list full");
        return false;
    }

    /* Check for duplicates */
    for (int i = 0; i < filter_count; i++) {
        if (filter_list[i] == can_id) {
            LOG_WRN("ID 0x%03X already in filter list", can_id);
            return false;
        }
    }

    filter_list[filter_count++] = can_id;
    LOG_INF("Added ID 0x%03X to %s", can_id, 
            whitelist_mode ? "whitelist" : "blacklist");
    return true;
}

/* Remove CAN ID from filter list */
bool filter_remove_id(uint32_t can_id)
{
    for (int i = 0; i < filter_count; i++) {
        if (filter_list[i] == can_id) {
            /* Shift remaining entries */
            for (int j = i; j < filter_count - 1; j++) {
                filter_list[j] = filter_list[j + 1];
            }
            filter_count--;
            LOG_INF("Removed ID 0x%03X from filter list", can_id);
            return true;
        }
    }
    LOG_WRN("ID 0x%03X not found in filter list", can_id);
    return false;
}

/* Clear all filters */
void filter_clear(void)
{
    filter_count = 0;
    LOG_INF("Filter list cleared");
}

/* Check if CAN ID should be accepted */
bool filter_check_id(uint32_t can_id)
{
    bool found = false;

    /* Search for ID in list */
    for (int i = 0; i < filter_count; i++) {
        if (filter_list[i] == can_id) {
            found = true;
            break;
        }
    }

    /* Whitelist: accept if found, reject if not found */
    /* Blacklist: reject if found, accept if not found */
    if (whitelist_mode) {
        /* Empty whitelist = accept nothing */
        return (filter_count == 0) ? false : found;
    } else {
        /* Empty blacklist = accept everything */
        return (filter_count == 0) ? true : !found;
    }
}

/* Get filter mode */
bool filter_is_whitelist(void)
{
    return whitelist_mode;
}

/* Set filter mode */
void filter_set_mode(bool is_whitelist)
{
    whitelist_mode = is_whitelist;
    LOG_INF("Filter mode changed to: %s", 
            whitelist_mode ? "Whitelist" : "Blacklist");
}

/* Get filter count */
uint8_t filter_get_count(void)
{
    return filter_count;
}

/* Get filter list */
void filter_get_list(uint32_t *list, uint8_t *count)
{
    if (list && count) {
        for (int i = 0; i < filter_count; i++) {
            list[i] = filter_list[i];
        }
        *count = filter_count;
    }
}
```

## src/uart_diagnostics.c
```c
#include <zephyr/kernel.h>
#include <zephyr/device.h>
#include <zephyr/drivers/uart.h>
#include <zephyr/shell/shell.h>
#include <zephyr/logging/log.h>
#include <stdio.h>

LOG_MODULE_REGISTER(uart_diag, LOG_LEVEL_DBG);

/* External functions */
extern void can_router_get_stats(uint32_t *rx, uint32_t *tx, uint32_t *filtered, uint32_t *errors);
extern void can_router_reset_stats(void);
extern bool filter_add_id(uint32_t can_id);
extern bool filter_remove_id(uint32_t can_id);
extern void filter_clear(void);
extern bool filter_is_whitelist(void);
extern void filter_set_mode(bool is_whitelist);
extern uint8_t filter_get_count(void);
extern void filter_get_list(uint32_t *list, uint8_t *count);

/* Shell command: show statistics */
static int cmd_stats(const struct shell *sh, size_t argc, char **argv)
{
    uint32_t rx, tx, filtered, errors;
    
    can_router_get_stats(&rx, &tx, &filtered, &errors);
    
    shell_print(sh, "CAN Gateway Statistics:");
    shell_print(sh, "  RX Frames:      %u", rx);
    shell_print(sh, "  TX Frames:      %u", tx);
    shell_print(sh, "  Filtered:       %u", filtered);
    shell_print(sh, "  Errors:         %u", errors);
    
    return 0;
}

/* Shell command: reset statistics */
static int cmd_stats_reset(const struct shell *sh, size_t argc, char **argv)
{
    can_router_reset_stats();
    shell_print(sh, "Statistics reset");
    return 0;
}

/* Shell command: show filter configuration */
static int cmd_filter_show(const struct shell *sh, size_t argc, char **argv)
{
    uint32_t list[32];
    uint8_t count;
    
    shell_print(sh, "Filter Mode: %s", 
                filter_is_whitelist() ? "Whitelist" : "Blacklist");
    
    filter_get_list(list, &count);
    shell_print(sh, "Filter Count: %u", count);
    
    if (count > 0) {
        shell_print(sh, "Filtered IDs:");
        for (int i = 0; i < count; i++) {
            shell_print(sh, "  0x%03X (%u)", list[i], list[i]);
        }
    }
    
    return 0;
}

/* Shell command: add filter ID */
static int cmd_filter_add(const struct shell *sh, size_t argc, char **argv)
{
    uint32_t can_id;
    
    if (argc < 2) {
        shell_error(sh, "Usage: filter add <CAN_ID>");
        return -1;
    }
    
    can_id = strtoul(argv[1], NULL, 0);
    
    if (filter_add_id(can_id)) {
        shell_print(sh, "Added ID 0x%03X to filter", can_id);
    } else {
        shell_error(sh, "Failed to add ID");
    }
    
    return 0;
}

/* Shell command: remove filter ID */
static int cmd_filter_remove(const struct shell *sh, size_t argc, char **argv)
{
    uint32_t can_id;
    
    if (argc < 2) {
        shell_error(sh, "Usage: filter remove <CAN_ID>");
        return -1;
    }
    
    can_id = strtoul(argv[1], NULL, 0);
    
    if (filter_remove_id(can_id)) {
        shell_print(sh, "Removed ID 0x%03X from filter", can_id);
    } else {
        shell_error(sh, "Failed to remove ID");
    }
    
    return 0;
}

/* Shell command: clear all filters */
static int cmd_filter_clear(const struct shell *sh, size_t argc, char **argv)
{
    filter_clear();
    shell_print(sh, "All filters cleared");
    return 0;
}

/* Shell command: set filter mode */
static int cmd_filter_mode(const struct shell *sh, size_t argc, char **argv)
{
    if (argc < 2) {
        shell_error(sh, "Usage: filter mode <whitelist|blacklist>");
        return -1;
    }
    
    if (strcmp(argv[1], "whitelist") == 0) {
        filter_set_mode(true);
        shell_print(sh, "Filter mode set to: Whitelist");
    } else if (strcmp(argv[1], "blacklist") == 0) {
        filter_set_mode(false);
        shell_print(sh, "Filter mode set to: Blacklist");
    } else {
        shell_error(sh, "Invalid mode. Use 'whitelist' or 'blacklist'");
        return -1;
    }
    
    return 0;
}

/* Register shell commands */
SHELL_STATIC_SUBCMD_SET_CREATE(filter_cmds,
    SHELL_CMD(show, NULL, "Show filter configuration", cmd_filter_show),
    SHELL_CMD(add, NULL, "Add CAN ID to filter", cmd_filter_add),
    SHELL_CMD(remove, NULL, "Remove CAN ID from filter", cmd_filter_remove),
    SHELL_CMD(clear, NULL, "Clear all filters", cmd_filter_clear),
    SHELL_CMD(mode, NULL, "Set filter mode (whitelist/blacklist)", cmd_filter_mode),
    SHELL_SUBCMD_SET_END
);

SHELL_STATIC_SUBCMD_SET_CREATE(stats_cmds,
    SHELL_CMD(show, NULL, "Show statistics", cmd_stats),
    SHELL_CMD(reset, NULL, "Reset statistics", cmd_stats_reset),
    SHELL_SUBCMD_SET_END
);

SHELL_CMD_REGISTER(stats, &stats_cmds, "CAN gateway statistics", NULL);
SHELL_CMD_REGISTER(filter, &filter_cmds, "CAN filter management", NULL);

/* Initialize UART diagnostics */
void uart_diagnostics_init(void)
{
    LOG_INF("UART diagnostics initialized");
    LOG_INF("Available commands:");
    LOG_INF("  stats show          - Display statistics");
    LOG_INF("  stats reset         - Reset statistics");
    LOG_INF("  filter show         - Show filter config");
    LOG_INF("  filter add <ID>     - Add CAN ID");
    LOG_INF("  filter remove <ID>  - Remove CAN ID");
    LOG_INF("  filter clear        - Clear all filters");
    LOG_INF("  filter mode <mode>  - Set whitelist/blacklist");
}
```
